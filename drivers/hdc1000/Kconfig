## drivers/hdc1000/Kconfig
```kconfig
# Copyright (c) 2020 HAW Hamburg
#
# This file is subject to the terms and conditions of the GNU Lesser
# General Public License v2.1. See the file LICENSE in the top level
# directory for more details.
#
menuconfig KCONFIG_MODULE_HDC1000
    bool "Configure HDC1000 driver"
    depends on MODULE_HDC1000
    help
        Configure the HDC1000 driver using Kconfig.

if KCONFIG_MODULE_HDC1000

config HDC1000_I2C_ADDRESS
    hex "HDC1000 I2C ADDRESS"
    range 0x40 0x43
    default 0x43
    help
        Change the I2C Slave Address.HDC1000 allows for upto 4 devices on Single Bus.
        The value depends on the state of ADR1 and ADR0 Pins.
        For more information refer section 8.5.1 in Datasheet (SNAS643C).

config HDC1000_CONVERSION_TIME
    int "HDC1000 CONVERSION TIME"
    range 13000 26000
    default 26000
    help
        This time value is chosen twice as large as needed for two 14-bit
        conversions (worst case) to allow for timer imprecision:
        (convert temp + convert hum) * 2 -> (6.5ms + 6.5ms) * 2 := 26ms.
        If both (temp and hum) conversion is not required the value may be halved.

endif # KCONFIG_MODULE_HDC1000
```

## sys/net/application_layer/Kconfig.mqttsn
```kconfig
# Copyright (c) 2020 Freie Universitaet Berlin
#
# This file is subject to the terms and conditions of the GNU Lesser
# General Public License v2.1. See the file LICENSE in the top level
# directory for more details.
#

menuconfig KCONFIG_MQTTSN
    bool "Configure MQTT-SN generic options"
    depends on USEMODULE_EMCUTE || USEMODULE_ASYMCUTE
    help
        Configure MQTT-SN generic configurations for client.

if KCONFIG_MQTTSN

config MQTTSN_DEFAULT_PORT
    int "Default UDP port for MQTT-SN client"
    range 0 65535
    default 1883
    help
        Configure the default UDP port for MQTT-SN client. This will write to 
        the macro 'CONFIG_MQTTSN_DEFAULT_PORT'. Usage can be found in the
        example implementation of Asymcute and Emcute. 

endif # KCONFIG_MQTTSN
```

## sys/net/gnrc/transport_layer/tcp/Kconfig
```kconfig
# Copyright (c) 2020 Freie Universitaet Berlin
#
# This file is subject to the terms and conditions of the GNU Lesser
# General Public License v2.1. See the file LICENSE in the top level
# directory for more details.
#
menuconfig KCONFIG_MODULE_GNRC_TCP
    bool "Configure GNRC_TCP"
    depends on MODULE_GNRC_TCP
    help
        Configure the GNRC_TCP using Kconfig.

if KCONFIG_MODULE_GNRC_TCP

config GNRC_TCP_CONNECTION_TIMEOUT_DURATION
    int "Timeout duration for user calls in microseconds"
    default 120000000
    help
        Timeout duration for user calls. Default value is 120000000 microseconds
        (2 minutes).

config GNRC_TCP_MSL
    int "Maximum segment lifetime (MSL) in microseconds"
    default 30000000
    help
        Maximum segment lifetime (MSL) in microseconds. Default value is 30
        seconds.

config GNRC_TCP_MSS_MULTIPLICATOR
    int "Number of MSS sized packets stored in receive buffer"
    default 1
    help
        Configure MSS Multiplicator i.e. number of MSS sized packets stored in
        receive buffer.

config GNRC_TCP_RCV_BUFFERS
    int "Number of preallocated receive buffers"
    default 1

config GNRC_TCP_RTO_LOWER_BOUND
    int "Lower bound for RTO in microseconds"
    default 1000000
    help
        Lower bound value for retransmission timeout (RTO) in microseconds.
        Default value is 1000000 microseconds (1 second). Retransmission
        timeout determines how long TCP waits for acknowledgment (ACK) of
        transmitted segment. Refer to RFC 6298 for more information.

config GNRC_TCP_RTO_UPPER_BOUND
    int "Upper bound for RTO in microseconds"
    default 60000000
    help
        Upper bound value for retransmission timeout (RTO) in microseconds.
        Default value is 60000000 microseconds (60 seconds). Refer to RFC 6298
        for more information.

config GNRC_TCP_RTO_GRANULARITY
    int "Clock granularity for RTO in microseconds"
    default 10000
    help
        Clock granularity for retransmission timeout (RTO) for TCP in
        microseconds. Default value is 10000000 microseconds (10 seconds). 
        Refer to RFC 6298 for more information.

config GNRC_TCP_RTO_A_DIV
    int "Alpha value for RTO calculation"
    default 8

config GNRC_TCP_RTO_B_DIV
    int "Beta value for RTO calculation"
    default 4

config GNRC_TCP_RTO_K
    int "K value for RTO calculation"
    default 4

config GNRC_TCP_PROBE_LOWER_BOUND
    int "Lower bound for the duration between probes in microseconds"
    default 1000000

config GNRC_TCP_PROBE_UPPER_BOUND
    int "Lower bound for the duration between probes in microseconds"
    default 60000000

endif # KCONFIG_MODULE_GNRC_TCP
```

## sys/net/lora/Kconfig
```kconfig
# Copyright (c) 2020 Freie Universitaet Berlin
#
# This file is subject to the terms and conditions of the GNU Lesser
# General Public License v2.1. See the file LICENSE in the top level
# directory for more details.
#
menuconfig KCONFIG_USEMODULE_LORA
    bool "Configure LoRa PHY"
    depends on USEMODULE_LORA
    help
        Configure LoRa PHY using Kconfig.

if KCONFIG_USEMODULE_LORA

config LORA_PREAMBLE_LENGTH_DEFAULT
    int "Preamble length"
    range 8 65537
    default 8
    help
        Configure preamble used in LoRa frame. Each LoRa frame begins with a
        preamble. It starts with a series of upchirps to cover the whole
        frequency band of the particular channel assigned. The last two upchirps
        encode the sync word. Sync word is used to differntiate between LoRa
        transmissions that use the same frequency bands. The sync word is
        followed by two and a quarter downchirps, for a duration of 2.25
        symbols. The total duration of this preamble can be configured between
        10.25 and 65,539.25 symbol hence the range 8 to 65537.

config LORA_SYMBOL_TIMEOUT_DEFAULT
    int "Timeout for symbols in seconds"
    default 10

choice
    bool "Channel bandwidth"
    default LORA_BW_DEFAULT_125
    help
        Configure the channel bandwidth. Refer to country specific regulations
        on channel usage to identify the correct bandwidth. If LoRaWAN MAC is
        being used, refer to "LoRaWAN Regional Parameters" by LoRa Alliance for
        more information.

config LORA_BW_DEFAULT_125
    bool "125kHz"

config LORA_BW_DEFAULT_250
    bool "250kHz"

config LORA_BW_DEFAULT_500
    bool "500kHz"

endchoice

choice
    bool "Spreading factor"
    default LORA_SF_DEFAULT_SF7
    help
        Configure Spreading Factor (SF). SF denotes the amount of spreading code
        applied to the original data signal. A larger SF increases the time on
        air, which increases energy consumption, reduces the data rate, and
        improves communication range. Each step up in spreading factor
        effectively doubles the time on air to transmit the same amount of data.
        Refer to country specific air time usage regulations before varying the
        SF. To calculate air time,in the case of LoRa, refer
        https://www.loratools.nl/#/airtime . If LoRaWAN is being used refer
        https://avbentem.github.io/airtime-calculator/ttn/eu868/12,12

config LORA_SF_DEFAULT_SF6
    bool "SF6"

config LORA_SF_DEFAULT_SF7
    bool "SF7"

config LORA_SF_DEFAULT_SF8
    bool "SF8"

config LORA_SF_DEFAULT_SF9
    bool "SF9"

config LORA_SF_DEFAULT_SF10
    bool "SF10"

config LORA_SF_DEFAULT_SF11
    bool "SF11"

config LORA_SF_DEFAULT_SF12
    bool "SF12"

endchoice

choice
    bool "Coding rate"
    default LORA_CR_DEFAULT_CR_4_5
    help
        Configure Coding rate (CR). CR denotes the implementation of forward
        error correction (FEC). This may be done by encoding 4-bit data with
        redundancies into 5-bit, 6-bit, 7-bit, or 8-bit. Coding Rate (CR) value
        need to be adjusted according to conditions of the channel used for data
        transmission. If there are too many interferences in the channel, then
        it’s recommended to increase the value of CR. However, the rise in CR
        value will also increase the duration for the transmission. Refer to
        country specific air time usage regulations before varying the CR. To
        calculate air time,in the case of LoRa, refer
        https://www.loratools.nl/#/airtime . If LoRaWAN MAC is being used, refer
        to "LoRaWAN Regional Parameters" by LoRa Alliance for more information.

config LORA_CR_DEFAULT_CR_4_5
    bool "CR 4/5"

config LORA_CR_DEFAULT_CR_4_6
    bool "CR 4/6"

config LORA_CR_DEFAULT_CR_4_7
    bool "CR 4/7"

config LORA_CR_DEFAULT_CR_4_8
    bool "CR 4/8"

endchoice

config LORA_IQ_INVERTED_DEFAULT
    bool "Enable inverted I/Q mode"
    help
        Enable Inverted I/Q while sending LoRa frames. Inverted I/Q allows
        differentiating sender and receiver messages. In the case of LoRaWAN,
        gateways receive messages with Inverted I/Q off and send messages with
        Inverted I/Q on. Nodes read messages with Inverted I/Q on and send
        messages with Inverted I/Q off. Set this to on if the device is to be
        used as a gateway.

config LORA_FREQUENCY_HOPPING_DEFAULT
    bool "Enable Frequency hopping spread spectrum (FHSS)"
    help
        Enabling Frequency hopping spread spectrum (FHSS) would imply that a
        portion of each LoRa packet is transmitted on each hopping channel from
        a look up table of frequencies managed by the host microcontroller.

config LORA_FREQUENCY_HOPPING_PERIOD_DEFAULT
    int "Frequency hopping period"
    default 0
    depends on LORA_FREQUENCY_HOPPING_DEFAULT
    help
        Configure the hopping period, time which each transmission will dwell in
        any given channel.

config LORA_FIXED_HEADER_LEN_MODE_DEFAULT
    bool "Enable fixed header length mode (implicit header)"
    help
        Enable fixed header length mode ( implicit header) to discard PHY header
        (PHDR). The mode is typically used in LoRaWAN beacons.

config LORA_PAYLOAD_CRC_OFF_DEFAULT
    bool "Disable payload CRC"

config LORA_PAYLOAD_LENGTH_DEFAULT
    int "Payload Length"
    default 0
    depends on !LORA_FIXED_HEADER_LEN_MODE_DEFAULT
    help
        Configure the length of payload. The option is disabled while using
        implicit header mode.

endif # KCONFIG_USEMODULE_LORA
```
